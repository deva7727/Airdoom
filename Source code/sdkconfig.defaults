## Source code/sdkconfig.defaults
```kconfig
CONFIG_ESP32_WIFI_NVS_ENABLED=y
CONFIG_MGMT_AP_SSID="AirDoom"
CONFIG_MGMT_AP_PASSWORD="airdoomadmin"
CONFIG_ESPTOOLPY_FLASHSIZE_4MB=y
CONFIG_ESPTOOLPY_FLASHSIZE="4MB"
CONFIG_PARTITION_TABLE_SINGLE_APP=y
```
